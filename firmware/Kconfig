## firmware/Kconfig
```kconfig
menu "DeskAgent board profile"

config DESK_BOARD_SENSECAP_WATCHER
    bool "Seeed SenseCAP Watcher"
    default n
    select ENABLE_AUDIO
    select PLATFORM_FLASHSIZE_32M
    help
        Select the Watcher board adapter. This is a DeskAgent project profile,
        not a TuyaOpen-provided board target.

endmenu

rsource "third_party/tclaw/Kconfig"
```

## firmware/esp_components/desk_watcher_deps/Kconfig.projbuild
```kconfig
config DESK_WATCHER_NATIVE_CODEC
    bool
    default y
    select CODEC_I2C_BACKWARD_COMPATIBLE
    select CODEC_ES8311_SUPPORT
    select CODEC_ES7243_SUPPORT
    select CODEC_ES7243E_SUPPORT
    help
        The Watcher LCD and codec share the preinstalled legacy I2C0 bus.
```

## firmware/sdkconfig.defaults
```kconfig
CONFIG_IDF_TARGET="esp32s3"
CONFIG_ESP32S3_SPIRAM_SUPPORT=y
CONFIG_SPIRAM_MODE_OCT=y
CONFIG_SPIRAM_TYPE_AUTO=y
CONFIG_ESP32S3_DEFAULT_CPU_FREQ_240=y
CONFIG_FREERTOS_HZ=1000
CONFIG_PARTITION_TABLE_CUSTOM=y
CONFIG_PARTITION_TABLE_CUSTOM_FILENAME="partitions.csv"
CONFIG_PARTITION_TABLE_OFFSET=0x8000
CONFIG_ESPTOOLPY_FLASHSIZE_32MB=y
CONFIG_ESPTOOLPY_FLASHSIZE="32MB"
CONFIG_ESPTOOLPY_FLASHMODE_QIO=y
CONFIG_ESPTOOLPY_FLASHFREQ_80M=y
CONFIG_ESP_MAIN_TASK_STACK_SIZE=3584
CONFIG_ESP_SYSTEM_EVENT_QUEUE_SIZE=32
CONFIG_LWIP_MAX_SOCKETS=16
CONFIG_LWIP_SO_RCVBUF=y
CONFIG_ENABLE_AUDIO_CODECS=y
CONFIG_AUDIO_CODEC_NAME="watcher_audio"
CONFIG_CODEC_I2C_BACKWARD_COMPATIBLE=y
```
